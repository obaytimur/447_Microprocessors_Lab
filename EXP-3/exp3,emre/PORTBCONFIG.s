GPIO_PORTB_DATA		EQU 0x400053FC	
GPIO_PORTB_DIR	 	EQU 0x40005400
GPIO_PORTB_AFSEL	EQU 0x40005420
GPIO_PORTB_DEN 		EQU 0x4000551C
SYSCTL_RCGCGPIO 	EQU 0x400FE608
		AREA	subroutine,	READONLY,	CODE,	ALIGN=2
		THUMB
		EXPORT	PORTBCONFIG

PORTBCONFIG	PROC
		LDR 	R1, =SYSCTL_RCGCGPIO
		LDR 	R0, [R1]
		ORR 	R0, R0, #0x02
		STR		R0, [R1]
		NOP
		NOP
		NOP
		LDR		R1, =GPIO_PORTB_DIR
		LDR 	R0, [R1]
		BIC 	R0, #0xFF
		ORR 	R0, #0x0F
		STR 	R0, [R1]
		LDR 	R1, =GPIO_PORTB_AFSEL
		LDR 	R0, [R1]
		BIC 	R0, #0xFF
		STR		R0, [R1]
		LDR 	R1, =GPIO_PORTB_DEN
		LDR 	R0, [R1]
		ORR 	R0, #0xFF
		STR 	R0, [R1]
		
		BX 		LR
		
		ALIGN	
		ENDP
			

			